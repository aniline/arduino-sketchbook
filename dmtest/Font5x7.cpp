#include "Arduino.h"
#include "Font5x7.h"
#include <avr/pgmspace.h>

#define FONT_LEN 480

const byte Font5x7[FONT_LEN] PROGMEM = {
   0x00, 0x01, 0x00, 0x3c, 0x12, 0x12, 0x3d, 0x00, 0x3e, 0x2a, 0x2a, 0x1d,
   0x00, 0x1c, 0x22, 0x22, 0x23, 0x00, 0x3e, 0x22, 0x22, 0x1d, 0x00, 0x3e,
   0x2a, 0x2a, 0x23, 0x00, 0x3e, 0x0a, 0x0a, 0x03, 0x00, 0x1c, 0x22, 0x2a,
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   0x00, 0x00, 0x00, 0x00, 0x00, 0x00, 0x00, 0x00, 0x00, 0x00, 0x00, 0x00 };

typedef struct {
     unsigned int offset:12;
     unsigned int len:4;
} t_index;

const t_index Font5x7_idx[128] PROGMEM = {
     {   0, 2 }, {   0, 2 }, {   0, 2 }, {   0, 2 }, {   0, 2 }, {   0, 2 }, {   0, 2 }, {   0, 2 },
     {   0, 2 }, {   0, 2 }, {   0, 2 }, {   0, 2 }, {   0, 2 }, {   0, 2 }, {   0, 2 }, {   0, 2 },
     {   0, 2 }, {   0, 2 }, {   0, 2 }, {   0, 2 }, {   0, 2 }, {   0, 2 }, {   0, 2 }, {   0, 2 },
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     { 225, 4 }, { 229, 4 }, { 233, 4 }, { 350, 4 }, { 375, 2 }, { 354, 4 }, {   0, 2 }, {   0, 2 },
};

int setup_Font5x7 () {
     return 0;
}

int write_letter(byte *buffer, int buffer_size, char v, int offs) {
  int rc = 0;
  unsigned int v_idx_val = pgm_read_word_near(Font5x7_idx+v);
  t_index v_idx = *((t_index*)&v_idx_val);
  if (offs <= 0) memset(buffer, 0, buffer_size);

  for (int i=0; i<v_idx.len; i++) {
    if ((offs + i)>=buffer_size) {
      return -1;
    }
    buffer[offs + i] = 0xFE & (pgm_read_byte_near(Font5x7+v_idx.offset+i));
  }

  return v_idx.len;
}

int write_string(byte *buffer, int buffer_size, char *str, int blit_offs) {
  int offs = blit_offs;
  int strsiz = strnlen(str, buffer_size);
  int i;
  int cols_used = 0;

  for (i = 0; i<strsiz; i++) {
    int cols = write_letter(buffer, buffer_size, str[i], offs);
    if (cols == -1) {
      return cols_used;
    } else {
      cols_used += cols;
      offs += cols;
    }
  }
  return cols_used;
}
